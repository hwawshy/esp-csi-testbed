## ap/sdkconfig.defaults
```kconfig
CONFIG_ESP32_WIFI_CSI_ENABLED=y
CONFIG_ESP_WIFI_PASSWORD=""
# CONFIG_ESP32_WIFI_AMPDU_TX_ENABLED is not set
```

## station/main/Kconfig.projbuild
```kconfig
menu "Example Configuration"

    config ESP_WIFI_SSID
        string "WiFi SSID"
        default "myssid"
        help
            SSID (network name) for the example to connect to.

    config ESP_WIFI_PASSWORD
        string "WiFi Password"
        default ""
        help
            WiFi password (WPA or WPA2) for the example to use.

    config AP_BSSID
        string "MAC address of AP"
        default "48:27:e2:3b:33:2d"
        help
            MAC address of the AP.

    config DB_HOST_IP
        string "DB IP Address"
        default "192.168.4.11"
        help
            IP address of the database host.
endmenu
```
